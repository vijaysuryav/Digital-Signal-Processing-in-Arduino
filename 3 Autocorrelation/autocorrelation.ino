float x[500]={2.047539376,-12.32353446,-6.431003187,-4.970284352,0.337550387,3.708442577,7.698761573,9.067202388,11.35315875,13.90709783,16.82518646,17.05161417,17.4293532,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-40.97055218,-45.32930395};
float r[500];
int N=500;

void setup() {
  Serial.begin(9600);  
}

void loop() {
  float fs=100;
  double sum;
  double r_zero;
  int fzcp;
  float amax;
  int lmax;
  float lmax1;
  float period;
  float bpm;

  for( int m=0;m<N;m++)
  {
    sum=0;
    for(int n=0;n<N-m;n++)
    {
      sum=sum+(x[n]*x[n+m]);
    }
    r[m]=sum; 
  }
  r_zero=r[0];   
  for( int m=0;m<N;m++)
  {
    r[m]=r[m]/r_zero;
  }
  for( int m=0;m<N;m++)
  {
    if(r[m]>=0 && r[m+1]<=0)
    {
      fzcp=m;
      break;
    }
  }
  amax=r[fzcp];
  for(int i=fzcp+1; i<N; i++)
  {
    if(r[i]>amax)
    {
      amax=r[i];
      lmax1=i;
    }
  }
  //lmax1=fzcp+lmax;
  period=lmax1/fs;
  bpm=60/period;
  Serial.print("Period = ");
  Serial.println(period);
  Serial.print("Beats per minute = ");
  Serial.println(bpm);

  for(int i=0;i<N;i++)
  {
    Serial.print(x[i]);
    Serial.print(' ');
    Serial.println(r[i]*100);
  }
}
